## drivers/misc/sprdwcn_bsp/sc2342/platform/Kconfig
```kconfig
config MARLIN2_SOC
	depends on SDIOM
	tristate "SPRD Marlin2 platform support"
	default n
	help
	  Enable this module if you want to use marlin2 chip including .
          This module support marlin2 chip platform for example:download,
          power ctl,sleep wakeup,at cmd,loopchek,mdbg,dump,marlin2 log .etc
	  Thanks.

config MARLIN2_FPGA
	bool "SPRD Marlin2 FPGA test"
	default n
        depends on MARLIN2_SOC
	help
	  only fpga test in marlin chip
```
